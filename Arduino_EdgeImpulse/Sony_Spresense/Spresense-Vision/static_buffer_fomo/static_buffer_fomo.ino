/*
 ************************************************************************************
 * Edge Impulse ingestion SDK                                                       * 
 * Copyright (c) 2022 EdgeImpulse Inc.                                              *        
 *                                                                                  *    
 * Licensed under the Apache License, Version 2.0 (the "License");                  *    
 * you may not use this file except in compliance with the License.                 *    
 * You may obtain a copy of the License at                                          *  
 * http://www.apache.org/licenses/LICENSE-2.0                                       *
 *                                                                                  *
 * Unless required by applicable law or agreed to in writing, software              *
 * distributed under the License is distributed on an "AS IS" BASIS,                *
 * WITHOUT WARRANTIES OR CONDITIONS OF ANY KIND, either express or implied.         *
 * See the License for the specific language governing permissions and              *
 * limitations under the License.                                                   *    
 *                                                                                  *
 ************************************************************************************
 * The MIT License (MIT)                                                            *
 *                                                                                  *
 * Modifications to the Software "Edge Impulse ingestion SDK"                       *
 * and saved herin as the Software "static_buffer_fomo.ino"                         *
 * Copyright (c) 2023 M. Marcial                                                    *
 * All Rights Reserved.                                                             *
 * If you use my code please give me credit.                                        *
 *                                                                                  *
 * Permission is hereby granted, free of charge, to any person obtaining a copy     *
 * of this software and associated documentation files (the "Software"), to deal    *
 * in the Software without restriction, including without limitation the rights     *
 * to use, copy, modify, merge, publish, distribute, sublicense, and/or sell        *
 * copies of the Software, and to permit persons to whom the Software is            *
 * furnished to do so, subject to the following conditions:                         *
 * The above copyright notice shall be included in                                  *    
 * all copies or substantial portions of the Software.                              *
 *                                                                                  *
 * THE SOFTWARE IS PROVIDED "AS IS", WITHOUT WARRANTY OF ANY KIND, EXPRESS OR       *
 * IMPLIED, INCLUDING BUT NOT LIMITED TO THE WARRANTIES OF MERCHANTABILITY,         *
 * FITNESS FOR A PARTICULAR PURPOSE AND NONINFRINGEMENT. IN NO EVENT SHALL THE      *
 * AUTHORS OR COPYRIGHT HOLDERS BE LIABLE FOR ANY CLAIM, DAMAGES OR OTHER           *
 * LIABILITY, WHETHER IN AN ACTION OF CONTRACT, TORT OR OTHERWISE, ARISING FROM,    *
 * OUT OF OR IN CONNECTION WITH THE SOFTWARE OR THE USE OR OTHER DEALINGS IN THE    *
 * SOFTWARE.                                                                        *
 ************************************************************************************
 */

/* Includes ---------------------------------------------------------------- */
#include <Spresense_FOMO_Screws_inferencing.h>  // <-- Replace with your " "Image Classification" or "FOMO" model library exported from the EdgeImpulse Studio Deployment page.

static const float features[] = {
    // Delete the data below in features[]. The data shown is an example of what ***your*** image data will look like
    // for an Impulse image input of width or 96 pixels and a height of 96 pixels for
    // an array size of 9216 (=96x96).
    // Copy ***your*** "Raw Features" here (for example from the 'Live classification' page).
    // Do not copy "Processed Features" here (for example from the 'Impulse Design-Image-Parameters' page).
    // See https://docs.edgeimpulse.com/docs/running-your-impulse-arduino.
    // For "Image Classification" or "FOMO" models we are copying in raw RGB integer values even tho "features[]" is declared as an array of floats.
    // We are only using "features[]" as a storage area, and will copy out the data byte-by-byte via function raw_feature_get_data().
0x352620, 0x33251f, 0x37261e, 0x332921, 0x332e20, 0x413725, 0x483628, 0x3d3426, 0x453725, 0x443421, 0x483423, 0x513929,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 0xadc0c8
};

/**
 * @brief      Copy raw 'feature data' into 'out_ptr'.
 *             Function called by inference library.
 *             Basically this function copies your raw feature data into area
 *             that the EdgeImpulse library knows about.
 *             Function run_classifier() typically calls this routine with length=1024
 *             and keeps incrementing offset until all data in 'features[]' is copied into 'out_ptr'.
 * @param[in]  offset   The 'offset' within 'feature[]'. 'offset' is an index into 'features[]'.
 * @param[in]  length   The 'length' of data to copy out
 * @param      out_ptr  The memory area that run_classifier() uses when makeing an inference.
 *
 * @return     0
 */
int raw_feature_get_data(size_t offset, size_t length, float *out_ptr)
{
    memcpy(out_ptr, features + offset, length * sizeof(float));
    return 0;
}


/**
 * @brief      Arduino setup function
 */
void setup()
{
    // Put your setup code here, to run once:
    Serial.begin(115200);
    
    // Comment out the below line to cancel the wait for USB connection (needed for native USB)
    while (!Serial);

    Serial.println("*** Edge Impulse Inferencing Demo ***");

    // Add statements here to see any konstants you are curious about.
    ei_printf("EI_CLASSIFIER_LABEL_COUNT=%d\n",            EI_CLASSIFIER_LABEL_COUNT);
    ei_printf("EI_CLASSIFIER_OBJECT_DETECTION_COUNT=%d\n", EI_CLASSIFIER_OBJECT_DETECTION_COUNT);
}

/**
 * @brief      Arduino main function
 */
void loop()
{
    ei_printf("Edge Impulse standalone inferencing (Arduino). About to make an inference...\n");

    if (sizeof(features) / sizeof(float) != EI_CLASSIFIER_DSP_INPUT_FRAME_SIZE)
    {
        ei_printf("The size of your 'features' array is not correct. Expected %lu items, but had %lu.\n",
                  EI_CLASSIFIER_DSP_INPUT_FRAME_SIZE, sizeof(features) / sizeof(float));
        delay(1000);
        return;
    }

    ei_impulse_result_t result = { 0 };   // Function run_classifier() places its results here.

    // The features[] are stored in flash, and we don't want to load everything into RAM.
    signal_t features_signal;
    features_signal.total_length = sizeof(features) / sizeof(features[0]);
    features_signal.get_data = &raw_feature_get_data;

    // Invoke the Impulse.
    EI_IMPULSE_ERROR res = run_classifier(&features_signal, &result, false /* debug */);

    ei_printf("Run_classifier returned: %d.\n", res);

    if (res != 0) return;

#if EI_CLASSIFIER_OBJECT_DETECTION == 1
    // FOMO Vision Model Details: Image Segmentation.

    // Print the Predictions
    ei_printf("Predictions (DSP: %d ms., Classification: %d ms., Total: %d ms.): \n",
             result.timing.dsp,  result.timing.classification,
             result.timing.dsp + result.timing.classification);

    bool bb_found = result.bounding_boxes[0].value > 0;

    if (!bb_found)
    {
      ei_printf("\tNo FOMO objects found.\n");
    }
    else
    {
      // NOTE: You can setup the following for-loop with either
      //       EI_CLASSIFIER_OBJECT_DETECTION_COUNT,
      //       EI_CLASSIFIER_LABEL_COUNT, or
      //       result.bounding_boxes_count.
      //       EI_CLASSIFIER_OBJECT_DETECTION_COUNT will always be equal to 10.
      //       result.bounding_boxes_count          will always be equal to 10.
      //       EI_CLASSIFIER_LABEL_COUNT will equal the numbers of classes in your Classification or FOMO model.
      for (size_t ix = 0; ix < EI_CLASSIFIER_OBJECT_DETECTION_COUNT; ix++)
      {
        auto bb = result.bounding_boxes[ix];
        if (bb.value == 0)
        {
          continue;                                       // If the bounding box prediction value if 0.0 then skip it.  
        }
        ei_printf("\t%s (%0.2f)", bb.label, bb.value);    // Can also use 'ei_printf_float()' to print floats as %0.5f.
                                                          // We choose "%0.2f" so we can match the value shown in the EI Studio 'Live Calssification' page.
        ei_printf("\t[ x: %u, y: %u, width: %u, height: %u ]\n", bb.x, bb.y, bb.width, bb.height);
      }
    }
    ei_printf("\n");      
#else
    // Vision Model Details: Image Classification.
    // Print the Predictions
    ei_printf("Predictions (DSP: %d ms., Classification: %d ms., Anomaly: %d ms, Total: %d ms.): \n",
             result.timing.dsp,  result.timing.classification,  result.timing.anomaly,
             result.timing.dsp + result.timing.classification + result.timing.anomaly);

    ei_printf("[");
    for (size_t ix = 0; ix < EI_CLASSIFIER_LABEL_COUNT; ix++)
    {
        ei_printf("%.5f", result.classification[ix].value);
#if EI_CLASSIFIER_HAS_ANOMALY == 1
        ei_printf(", ");
#else
        if (ix != EI_CLASSIFIER_LABEL_COUNT - 1) {
            ei_printf(", ");
        }
#endif
    }
#if EI_CLASSIFIER_HAS_ANOMALY == 1
    ei_printf("%.3f", result.anomaly);
#endif
    ei_printf("]\n");

    // Show Human-Readable Predictions
    for (size_t ix = 0; ix < EI_CLASSIFIER_LABEL_COUNT; ix++)
    {
        ei_printf("    %s: %.5f\n", result.classification[ix].label, result.classification[ix].value);
    }
#if EI_CLASSIFIER_HAS_ANOMALY == 1
    ei_printf("    anomaly score: %.3f\n", result.anomaly);
#endif
    ei_printf("\n");
#endif  //End --- Vision Model Details: Image Classification.

    delay(1000);
}
